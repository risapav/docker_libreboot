## update/src/coreboot/default/src/mainboard/lenovo/x220/Kconfig.name
```kconfig
config BOARD_LENOVO_X220
	bool "ThinkPad X220"

config BOARD_LENOVO_X220I
	bool "ThinkPad X220i"

config BOARD_LENOVO_X1
	bool "ThinkPad X1"
	
config BOARD_LENOVO_X220_EDP
	bool "ThinkPad X220 eDP Mod (2K/FHD)"
```
